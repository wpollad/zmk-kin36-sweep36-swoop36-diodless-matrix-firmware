## config/west.yml
```yaml
manifest:
  remotes:
    - name: zmkfirmware
      url-base: https://github.com/zmkfirmware
    # Additional modules containing boards/shields/custom code can be listed here as well
    # See https://docs.zephyrproject.org/3.2.0/develop/west/manifest.html#projects
    - name: zmk
      url-base: https://github.com/nxtkb
  projects:
    # - name: zmk
    #   remote: zmkfirmware
    #   revision: main
    #   import: app/west.yml
    - name: zmk
      remote: zmk
      revision: legacy-main-2026-08-30  # pinned: the fork moved main to Zephyr 4.1; this branch keeps send-string/report behaviors
      import: app/west.yml
  self:
    path: config
```
