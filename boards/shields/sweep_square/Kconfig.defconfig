## boards/shields/sweep_square/Kconfig.defconfig
```kconfig
# Copyright (c) 2020 The ZMK Contributors
# SPDX-License-Identifier: MIT

if SHIELD_SWEEP_SQUARE_LEFT

config ZMK_KEYBOARD_NAME
    default "Sweep Square"

config ZMK_SPLIT_ROLE_CENTRAL
    default y

endif

if SHIELD_SWEEP_SQUARE_LEFT || SHIELD_SWEEP_SQUARE_RIGHT

config ZMK_SPLIT
    default y

endif
```

## boards/shields/sweep_square/Kconfig.shield
```kconfig
# Copyright (c) 2020 The ZMK Contributors
# SPDX-License-Identifier: MIT

config SHIELD_SWEEP_SQUARE_LEFT
    def_bool $(shields_list_contains,sweep_square_left)

config SHIELD_SWEEP_SQUARE_RIGHT
    def_bool $(shields_list_contains,sweep_square_right)
```
